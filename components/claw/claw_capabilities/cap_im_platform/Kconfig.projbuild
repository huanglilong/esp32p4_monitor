## components/claw/claw_capabilities/cap_im_platform/Kconfig.projbuild
```kconfig
menu "ESP-Claw IM Platform Channels"

config APP_CLAW_CAP_IM_LOCAL
    bool "Enable local / Web IM capability (cap_im_local)"
    default y
    help
        Register cap_im_local for in-process IM (e.g. Web Agent Chat).
        Provides a local IM channel that routes messages through the
        event router without requiring external IM platforms (WeChat/TG/etc).
        Outbound messages are delivered via a registered callback,
        typically connected to the Web Agent Chat UI.

config APP_CLAW_CAP_IM_FEISHU
    bool "Enable Feishu (Lark) IM channel"
    default n
    help
        Enable the Feishu/Lark bot channel for ESP-Claw.
        Uses WebSocket for inbound messages and REST API for outbound.
        Requires Feishu App ID and App Secret to be configured.

config APP_CLAW_CAP_IM_QQ
    bool "Enable QQ IM channel"
    default n
    help
        Enable the QQ bot channel for ESP-Claw.
        Uses WebSocket for inbound messages and REST API for outbound.
        Requires QQ App ID and App Secret to be configured.

config APP_CLAW_CAP_IM_TG
    bool "Enable Telegram IM channel"
    default n
    help
        Enable the Telegram bot channel for ESP-Claw.
        Uses long polling for inbound messages and Bot API for outbound.
        Requires Telegram Bot Token to be configured.

config APP_CLAW_CAP_IM_WECHAT
    bool "Enable WeChat IM channel"
    default n
    help
        Enable the WeChat iLink Bot channel for ESP-Claw.
        Uses QR scan login and long polling for inbound messages.
        Supports text and image sending (no generic file).
        Requires bot_token obtained via QR login flow.

endmenu
```

## components/example_video_common/Kconfig.projbuild
```kconfig
menu "Example Video Configuration"

    choice EXAMPLE_SELECT_DEV_BOARD
        prompt "Select Development Board"
        default EXAMPLE_SELECT_CUSTOMIZED_DEV_BOARD
        help
            Select the target development board.

        config EXAMPLE_SELECT_CUSTOMIZED_DEV_BOARD
            bool "Customized Development Board"
            help
                Customized development board for Waveshare ESP32-P4-WiFi6-Touch-LCD-4B.
    endchoice

    config EXAMPLE_ENABLE_MIPI_CSI_CAM_SENSOR
        bool "Enable MIPI-CSI Camera Sensor"
        default y
        help
            Enable MIPI-CSI camera sensor support.

    config EXAMPLE_SCCB_I2C_INIT_BY_APP
        bool "Use Pre-initialized SCCB(I2C) Bus for Camera Sensor"
        default y
        help
            Share the pre-initialized I2C bus for camera SCCB.

    config EXAMPLE_SCCB_I2C_PORT_INIT_BY_APP
        int "SCCB(I2C) Port Number"
        default 0
        depends on EXAMPLE_SCCB_I2C_INIT_BY_APP
        help
            I2C port number for camera SCCB.

    config EXAMPLE_MIPI_CSI_SCCB_I2C_PORT
        int "MIPI-CSI SCCB I2C Port"
        default 0
        help
            I2C port for MIPI-CSI camera SCCB.

    config EXAMPLE_MIPI_CSI_SCCB_I2C_FREQ
        int "MIPI-CSI SCCB I2C Frequency (Hz)"
        default 100000
        help
            I2C frequency for MIPI-CSI camera SCCB.

    config EXAMPLE_JPEG_COMPRESSION_QUALITY
        int "JPEG compression quality (%)"
        default 80
        range 1 100
        help
            JPEG compression quality percentage (1-100).

    config EXAMPLE_CAMERA_VIDEO_BUFFER_NUMBER
        int "Camera video buffer number"
        default 2
        help
            Number of video buffers for the camera sensor.

    config EXAMPLE_HTTP_PART_BOUNDARY
        string "HTTP part boundary"
        default "123456789000000000000987654321"
        help
            HTTP multipart boundary string used for MJPEG streaming.

    config EXAMPLE_MDNS_INSTANCE
        string "mDNS instance"
        default "web-cam"
        help
            mDNS instance name for service discovery.

    config EXAMPLE_MDNS_HOST_NAME
        string "mDNS host name"
        default "esp-web"
        help
            mDNS host name for the device.
endmenu
```

## components/ulog/Kconfig.projbuild
```kconfig
menu "ULog Logger Configuration"

    config ULOG_ENABLE
        bool "Enable ULog file logging"
        default n
        help
            Enable writing uORB topics to SD card in ULog format.
            Logs are written to /sdcard/log/session_*.ulg.

    if ULOG_ENABLE

        config ULOG_RINGBUF_SIZE
            int "Ring buffer size (bytes)"
            default 16384
            range 4096 131072
            help
                Size of the internal ring buffer for decoupling data
                collection from SD card writes. Larger buffers reduce
                the chance of data loss during burst writes.

        config ULOG_FLUSH_INTERVAL_MS
            int "File flush interval (ms)"
            default 100
            range 20 1000
            help
                How often to drain the ring buffer to the SD card file.
                Lower values reduce data loss risk but increase I/O overhead.

        config ULOG_SYNC_INTERVAL_MS
            int "Sync marker interval (ms)"
            default 500
            range 100 5000
            help
                How often to insert SYNC markers in the data section for
                crash recovery. Accepted by PX4 tools (Flight Review).

        config ULOG_FSYNC_INTERVAL_MS
            int "fsync interval (ms)"
            default 1000
            range 200 10000
            help
                How often to call fsync() to ensure data is written to
                the SD card. More frequent fsync reduces data loss on
                power failure but increases write latency.

        config ULOG_DEFAULT_INTERVAL_MS
            int "Default topic sampling interval (ms)"
            default 100
            range 10 5000
            help
                Default sampling interval for topics that don't specify
                their own interval.

        config ULOG_TASK_STACK_SIZE
            int "Writer task stack size (bytes)"
            default 4096
            range 2048 16384
            help
                Stack size for the ULog writer FreeRTOS task.

        config ULOG_TASK_PRIORITY
            int "Writer task priority"
            default 5
            range 1 25
            help
                Priority of the ULog writer task. Higher = more CPU time
                for draining the buffer.

        config ULOG_MAX_SESSIONS
            int "Max retained session files"
            default 10
            range 1 999
            help
                Maximum number of .ulg files to retain on the SD card.
                Once exceeded, the oldest file is overwritten.

    endif

endmenu
```
